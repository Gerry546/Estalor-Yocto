## layers/meta-estalor-bsp/conf/layer.conf
```bitbake
# We have a conf and classes directory, add to BBPATH
BBPATH .= ":${LAYERDIR}"

# We have recipes-* directories, add to BBFILES
BBFILES += "${LAYERDIR}/recipes-*/*/*.bb \
            ${LAYERDIR}/recipes-*/*/*.bbappend"

BBFILE_COLLECTIONS += "meta-estalor-bsp"
BBFILE_PATTERN_meta-estalor-bsp = "^${LAYERDIR}/"
BBFILE_PRIORITY_meta-estalor-bsp = "20"

LAYERDEPENDS_meta-estalor-bsp = "core"
LAYERSERIES_COMPAT_meta-estalor-bsp = "mickledore"
```

## layers/meta-estalor-bsp/conf/machine/qemuarm64-a53.conf
```bitbake
#@TYPE: Machine
#@NAME: QEMU ARMv8 machine with A53 tuning
#@DESCRIPTION: Machine configuration for running an ARMv8 system on QEMU

MACHINEOVERRIDES = "qemuarm64:${MACHINE}"

# Machine settings
#########################################
require conf/machine/include/arm/armv8a/tune-cortexa53.inc
require conf/machine/include/qemu.inc

KERNEL_IMAGETYPE = "Image"
KMACHINE = "qemuarm64"

MACHINE_FEATURES:append = " \
    vfat \
    usbgadget \
    usbhost \
"

IMAGE_FSTYPES:append = " \
    wic \
    ext4 \
"

EXTRA_IMAGEDEPENDS:append = " u-boot"

# WIC settings
#########################################
WKS_FILES = "qemuarm64.wks"

IMAGE_BOOT_FILES = "\
    ${KERNEL_IMAGETYPE} \
    u-boot.bin \
    boot.scr \
"

do_image_wic:append[depends] = " \
    virtual/bootloader:do_deploy \
"

# Bootloader settings
#########################################
UBOOT_MACHINE = "qemu_arm64_defconfig"
# Ensure that U-Boot is using the boot script instead of extern Linux Kernel directly
UBOOT_EXTLINUX = "0"
KERNEL_BOOTCMD = "booti"

# Debug settings
#########################################
SERIAL_CONSOLES ?= "115200;ttyAMA0 115200;hvc0"
SERIAL_CONSOLES_CHECK = "${SERIAL_CONSOLES}"

# Qemu Settings
#########################################
QB_SYSTEM_NAME = "qemu-system-aarch64"
QB_MACHINE = "-machine virt"
QB_CPU = "-cpu cortex-a53"
QB_SMP ?= "-smp 4"
QB_CPU_KVM = "-cpu host -machine gic-version=3"
# For graphics to work we need to define the VGA device as well as the necessary USB devices
QB_GRAPHICS = "-device virtio-gpu-pci"
QB_OPT_APPEND = "-device qemu-xhci -device usb-tablet -device usb-kbd"
# Virtio Networking support
QB_TAP_OPT = "-netdev tap,id=net0,ifname=@TAP@,script=no,downscript=no"
QB_NETWORK_DEVICE = "-device virtio-net-pci,netdev=net0,mac=@MAC@"
# Virtio block device
QB_ROOTFS_OPT = "-drive id=disk0,file=@ROOTFS@,if=none,format=raw -device virtio-blk-pci,drive=disk0"
# Virtio serial console
QB_SERIAL_OPT = "-device virtio-serial-pci -chardev null,id=virtcon -device virtconsole,chardev=virtcon"
QB_TCPSERIAL_OPT = "-device virtio-serial-pci -chardev socket,id=virtcon,port=@PORT@,host=127.0.0.1 -device virtconsole,chardev=virtcon"
# Bootloader
QB_DEFAULT_BIOS = "u-boot.bin"
QB_FSINFO = "wic:no-kernel-in-fs"
QB_KERNEL_ROOT = "/dev/vda3"
QB_DRIVE_TYPE = "/dev/vd"
QB_DEFAULT_FSTYPE = "ext4"
# Port forwarding settings
QB_SLIRP_OPT="-netdev user,id=net0,hostfwd=tcp::3218-:8123,hostfwd=tcp::2222-:22"
```

## layers/meta-estalor-bsp/conf/machine/reterminal.conf
```bitbake
#@TYPE: Machine
#@NAME: RaspberryPi 4 Compute Module in the reterminal
#@DESCRIPTION: Machine configuration for the RaspberryPi 4 in 64 bits mode

MACHINEOVERRIDES = "raspberrypi4:raspberrypi4-64:${MACHINE}"

# Machine settings
#########################################
require conf/machine/raspberrypi4-64.conf

# We want the UART so that we can easily use a serial terminal while debugging
ENABLE_UART = "1"

IMAGE_FSTYPES:append = " \
    wic \
    ext4 \
"

# WIC settings
#########################################
WKS_FILES = "reterminal.wks"

# Bootloader settings
#########################################
# Default for the distro to U-Boot
RPI_USE_U_BOOT = "1"
```

## layers/meta-estalor-distro/conf/distro/estalor.conf
```bitbake
# Generic information
################################
DISTRO = "estalor"
DISTRO_NAME = "estalor"
DISTRO_VERSION = "0.1"
SDK_VENDOR = "-estalorsdk"
MAINTAINER = "Tom Geelen <t.f.g.geelen@gmail.com>"

# Distro tweaking
################################
DISTRO_FEATURES = "\
"

PREFERRED_PROVIDER_virtual/kernel = "linux-yocto"

# Let's ensure all is dynamically linked
require conf/distro/include/no-static-libs.inc

# And add some security flags
require conf/distro/include/security_flags.inc

# Infrastructure
################################
# Prevent stacking up old builds and do not symlink everything
IMAGE_NAME = "${IMAGE_BASENAME}-${MACHINE}"
IMAGE_LINK_NAME = ""
# Default the temp directory name in the build folder to tmp
TCLIBCAPPEND = ""
```

## layers/meta-estalor-distro/conf/layer.conf
```bitbake
# We have a conf and classes directory, add to BBPATH
BBPATH .= ":${LAYERDIR}"

# We have recipes-* directories, add to BBFILES
BBFILES += "${LAYERDIR}/recipes-*/*/*.bb \
            ${LAYERDIR}/recipes-*/*/*.bbappend"

BBFILE_COLLECTIONS += "meta-estalor-distro"
BBFILE_PATTERN_meta-estalor-distro = "^${LAYERDIR}/"
BBFILE_PRIORITY_meta-estalor-distro = "20"

LAYERDEPENDS_meta-estalor-distro = "\
    core \
    openembedded-layer \
"
LAYERSERIES_COMPAT_meta-estalor-distro = "mickledore"
```

## layers/meta-estalor-distro/wic/qemuarm64.wks
```
# short-description: Create Qemu disk image
# long-description: Creates a partitioned Qemu disk image consisting of
# - boot partition
# - empty partition which is used for the u-boot env
# - 2x partition for the kernel partitions
# - 2x rootfs partition for A/B partitioning
# - data partition

bootloader --ptable gpt

part --source bootimg-partition --ondisk vda --fstype vfat --label boot --active --align 4096 --fixed-size 50M
part --fixed-size 10M --ondisk vda --align 4096 --label uboot-env --fstype vfat
part --source rawcopy --sourceparams="file=kernel-part.vfat" --fixed-size 100M --ondisk vda --align 4096 --label kernel_a --fstype vfat
part --source rawcopy --sourceparams="file=kernel-part.vfat" --fixed-size 100M --ondisk vda --align 4096 --label kernel_b --fstype vfat
part --fixed-size 500M --source rootfs --ondisk vda --fstype=ext4 --label root_a --align 4096
part --fixed-size 500M --source rootfs --ondisk vda --fstype=ext4 --label root_b --align 4096
part --fixed-size 100M --ondisk vda --fstype=ext4 --label data --align 4096
```

## layers/meta-estalor-distro/wic/reterminal.wks
```
# short-description: Create Reterminal partition scheme
# long-description: Create a partitioned image consisting of
# - 1x boot partition
# - 2x kernel partition for A/B partitioning with kernel upgrades
# - 2x rootfs partition for A/B partitioning
# - data partition for persistent storage
# - storage partition for other logs

bootloader --ptable gpt

part /boot --source bootimg-partition --ondisk mmcblk0 --fstype=vfat --label boot --active --align 4096 --fixed-size 100M

part --source rawcopy --sourceparams="file=kernel-part.vfat" --fixed-size 100M --ondisk mmcblk0 --align 4096 --label kernel_a --fstype vfat
part --source rawcopy --sourceparams="file=kernel-part.vfat" --fixed-size 100M --ondisk mmcblk0 --align 4096 --label kernel_b --fstype vfat

part / --source rootfs --fixed-size 3G --ondisk mmcblk0 --fstype=ext4 --label rootfs_A --align 4096
part / --source rootfs --fixed-size 3G --ondisk mmcblk0 --fstype=ext4 --label rootfs_B --align 4096

part /data    --ondisk mmcblk0 --fstype=ext4 --label data    --align 4096 --fixed-size 100M 
part /ha-conf --ondisk mmcblk0 --fstype=ext4 --label ha-conf --align 4096 --fixed-size 4G
part /storage --ondisk mmcblk0 --fstype=ext4 --label storage --align 4096 --size 18G --fsoptions "x-systemd.growfs"
```

## layers/meta-estalor/conf/distro/estalor.conf
```bitbake
# Generic information
################################
DISTRO = "estalor"
DISTRO_NAME = "estalor"
DISTRO_VERSION = "0.1"
SDK_VENDOR = "-estalorsdk"
MAINTAINER = "Tom Geelen <t.f.g.geelen@gmail.com>"

# Distro tweaking
################################
DISTRO_FEATURES = "\
    acl \
    bluetooth \
    ipv4 \
    rauc \
    systemd \
    usbgadget \
    usbhost \
    usrmerge \
    vfat \
    wifi \
    xattr \
    zeroconf \
"

DISTRO_FEATURES:append:reterminal = "\
    wayland \
    opengl \
    pam \
"

# We are going full wayland so remove all conflicting backends
DISTRO_FEATURES:remove:reterminal = "\
    directfb \
    x11 \
"

PREFERRED_PROVIDER_virtual/kernel:qemuarm64 = "linux-yocto"
PREFERRED_PROVIDER_virtual/kernel:reterminal = "linux-raspberrypi"

# Include list of CVE's which can be ignored
include conf/distro/include/cve-extra-exclusions.inc

# Let's ensure all is dynamically linked
require conf/distro/include/no-static-libs.inc

# And add some security flags
require conf/distro/include/security_flags.inc

# Systemd is part of the distro features so let's remove sysvinit
DISTRO_FEATURES_BACKFILL_CONSIDERED = "sysvinit"
VIRTUAL-RUNTIME_init_manager = "systemd"
VIRTUAL-RUNTIME_initscripts = ""

# Infrastructure
################################
# Prevent stacking up old builds and do not symlink everything
IMAGE_NAME = "${IMAGE_BASENAME}${IMAGE_MACHINE_SUFFIX}${IMAGE_NAME_SUFFIX}"
IMAGE_LINK_NAME = ""
# Default the temp directory name in the build folder to tmp
TCLIBCAPPEND = ""
```

## layers/meta-estalor/conf/layer.conf
```bitbake
# We have a conf and classes directory, add to BBPATH
BBPATH .= ":${LAYERDIR}"

# We have recipes-* directories, add to BBFILES
BBFILES += "${LAYERDIR}/recipes-*/*/*.bb \
            ${LAYERDIR}/recipes-*/*/*.bbappend"

BBFILE_COLLECTIONS += "meta-estalor"
BBFILE_PATTERN_meta-estalor = "^${LAYERDIR}/"
BBFILE_PRIORITY_meta-estalor = "22"

LAYERDEPENDS_meta-estalor = "\
"

LAYERSERIES_COMPAT_meta-estalor = "nanbield"
```

## layers/meta-estalor/conf/machine/reterminal.conf
```bitbake
#@TYPE: Machine
#@NAME: RaspberryPi 4 Compute Module in the reterminal
#@DESCRIPTION: Machine configuration for the RaspberryPi 4 in 64 bits mode

MACHINEOVERRIDES = "raspberrypi4:raspberrypi4-64:${MACHINE}"

# Machine settings
#########################################
require conf/machine/raspberrypi4-64.conf

# We want the UART so that we can easily use a serial terminal while debugging
ENABLE_UART = "1"

# Since several devices are connected to the I2C bus (such as the screen) we will need I2C
ENABLE_I2C = "1"
KERNEL_MODULE_AUTOLOAD:append = " i2c-dev"
KERNEL_MODULE_AUTOLOAD:append = " als_ltr30x"
KERNEL_MODULE_AUTOLOAD:append = " lis331dlh-i2c"

IMAGE_FSTYPES = " \
    wic.bz2 \
    wic.bmap \
    ext4 \
"

MACHINE_FEATURES:append = " \
    usbhost \
    touchscreen \
    wifi \
    rtc \
    pci \
"

# Add additional dtbo files to the devicetree
RPI_KERNEL_DEVICETREE_OVERLAYS:append = "\
    overlays/i2c3.dtbo \
    overlays/vc4-kms-v3d-pi4.dtbo \
    overlays/reterminal.dtbo \
"

# Enable Reterminal hardware
ENABLE_RETERMINAL = "1"

# WIC settings
#########################################
WKS_FILES = "reterminal.wks"

# Bootloader settings
#########################################
# Default for the distro to U-Boot
RPI_USE_U_BOOT = "1"
```
